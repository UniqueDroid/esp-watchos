## sdkconfig.defaults
```kconfig
CONFIG_IDF_TARGET="esp32c6"
CONFIG_ESPTOOLPY_FLASHMODE_QIO=y
CONFIG_ESPTOOLPY_FLASHSIZE_16MB=y
CONFIG_PARTITION_TABLE_CUSTOM=y
CONFIG_COMPILER_OPTIMIZATION_PERF=y
# Note: ESP-IDF v6.0 has no PSRAM/SPIRAM Kconfig support for ESP32-C6 at all
# (no esp_psram/esp32c6/Kconfig.spiram) - these settings are intentionally
# absent. All heap is internal SRAM; budget UI/buffers accordingly.
CONFIG_ESP_DEFAULT_CPU_FREQ_MHZ_240=y
CONFIG_BSP_I2C_NUM=0
# Default LVGL draw buffer height is 100 lines (~80KB at 410px wide RGB565) -
# the single largest static RAM consumer on this no-PSRAM board. Reduced to
# free headroom for apps/services; costs more SPI flush passes on full-screen
# redraws, negligible for partial UI updates.
CONFIG_BSP_DISPLAY_LVGL_BUF_HEIGHT=40
CONFIG_FREERTOS_HZ=1000
CONFIG_LV_USE_CLIB_MALLOC=y
CONFIG_LV_USE_CLIB_STRING=y
CONFIG_LV_USE_CLIB_SPRINTF=y
CONFIG_LV_DEF_REFR_PERIOD=15
CONFIG_LV_OS_FREERTOS=y
CONFIG_LV_DRAW_SW_DRAW_UNIT_CNT=1
CONFIG_LV_FONT_DEFAULT_MONTSERRAT_18=y
CONFIG_LV_FONT_MONTSERRAT_12=y
CONFIG_LV_FONT_MONTSERRAT_16=y
CONFIG_LV_FONT_MONTSERRAT_18=y
CONFIG_LV_FONT_MONTSERRAT_20=y
CONFIG_LV_FONT_MONTSERRAT_22=y
CONFIG_LV_FONT_MONTSERRAT_24=y
CONFIG_LV_FONT_MONTSERRAT_26=y
CONFIG_LV_USE_FONT_COMPRESSED=y
CONFIG_LV_TXT_BREAK_CHARS=" ,.;:-_"
CONFIG_IDF_EXPERIMENTAL_FEATURES=y

CONFIG_LV_FONT_MONTSERRAT_8=y
CONFIG_LV_FONT_MONTSERRAT_10=y
CONFIG_LV_FONT_MONTSERRAT_28=y
CONFIG_LV_FONT_MONTSERRAT_30=y
CONFIG_LV_FONT_MONTSERRAT_32=y
CONFIG_LV_FONT_MONTSERRAT_34=y
CONFIG_LV_FONT_MONTSERRAT_36=y
CONFIG_LV_FONT_MONTSERRAT_38=y
CONFIG_LV_FONT_MONTSERRAT_40=y
CONFIG_LV_FONT_MONTSERRAT_42=y
CONFIG_LV_FONT_MONTSERRAT_44=y
CONFIG_LV_FONT_MONTSERRAT_48=y
CONFIG_LV_FONT_FMT_TXT_LARGE=y
CONFIG_LV_USE_SNAPSHOT=y
CONFIG_LV_BUILD_EXAMPLES=n
CONFIG_LV_USE_KEYBOARD=y

CONFIG_ESP_BROOKESIA_ENABLE_AI_FRAMEWORK=n
CONFIG_ESP_BROOKESIA_GUI_ENABLE_ANIM_PLAYER=n
CONFIG_ESP_BROOKESIA_ENABLE_SERVICES=n
CONFIG_ESP_BROOKESIA_SYSTEMS_ENABLE_SPEAKER=n
CONFIG_BOOST_MATH_ENABLED=n
CONFIG_BOOST_SERIALIZATION_ENABLED=n

CONFIG_MDNS_MAX_SERVICES=12
CONFIG_LWIP_MAX_SOCKETS=16

# NimBLE, used by bt_shared for BLE advertising (see components/system/bt_shared).
# Peripheral/Broadcaster roles are required to advertise at all - without them
# the stack can only scan/connect to other devices, never be found itself.
# Extended advertising is explicitly left off: it disables the legacy
# ble_gap_adv_* API bt_shared.c uses (fails with BLE_HS_ENOTSUP otherwise),
# and nothing here needs BLE 5 extended-advertising features.
CONFIG_BT_ENABLED=y
CONFIG_BT_NIMBLE_ENABLED=y
CONFIG_BT_NIMBLE_ROLE_PERIPHERAL=y
CONFIG_BT_NIMBLE_ROLE_BROADCASTER=y
# CONFIG_BT_NIMBLE_EXT_ADV is not set
```
